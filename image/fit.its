## image/fit.its
```
/dts-v1/;
/ {
    description = "OpenWrt mitrastar gpt-2742gx4x5v6 (fitblk)";
    #address-cells = <1>;
    images {
        fdt@1 {
            description = "ARM OpenWrt device tree blob";
            data = /incbin/("fit_dtb_fitblk.bin");
            type = "flat_dt"; arch = "arm"; compression = "none";
            hash@1 { algo = "crc32"; }; hash@2 { algo = "sha1"; };
        };
        kernel@1 {
            description = "ARM OpenWrt Linux kernel";
            data = /incbin/("kernel_lzma_fitblk.bin");
            type = "kernel"; arch = "arm"; os = "linux"; compression = "lzma";
            load = <0x80208000>; entry = <0x80208000>;
            hash@1 { algo = "crc32"; }; hash@2 { algo = "sha1"; };
        };
        filesystem@1 {
            description = "ARM OpenWrt root filesystem";
            data = /incbin/("root.squashfs");
            type = "filesystem"; arch = "arm"; os = "linux"; compression = "none";
            hash@1 { algo = "crc32"; }; hash@2 { algo = "sha1"; };
        };
    };
    configurations {
        default = "conf@1";
        conf@1 { description = "OpenWrt"; fdt = "fdt@1"; kernel = "kernel@1"; filesystem = "filesystem@1"; };
    };
};
```
